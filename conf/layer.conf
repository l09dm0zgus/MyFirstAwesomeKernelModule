## conf/layer.conf
```bitbake
# We have a conf and classes directory, add to BBPATH
BBPATH .= ":${LAYERDIR}"

# We have recipes-* directories, add to BBFILES
BBFILES += "${LAYERDIR}/recipes-*/*/*.bb \
            ${LAYERDIR}/recipes-*/*/*.bbappend"

BBFILE_COLLECTIONS += "MyFirstAwesomeKernelModule"
BBFILE_PATTERN_MyFirstAwesomeKernelModule = "^${LAYERDIR}/"
BBFILE_PRIORITY_MyFirstAwesomeKernelModule = "6"

LAYERDEPENDS_MyFirstAwesomeKernelModule = "core"
LAYERSERIES_COMPAT_MyFirstAwesomeKernelModule = "mickledore"
```
